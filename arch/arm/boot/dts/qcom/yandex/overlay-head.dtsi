#include "msm-audio.dtsi"
#include "msm-pm660.dtsi"
#include "msm-pm660l.dtsi"
#include "sdm630-camera-sensor-mtp.dtsi"
#include "sdm630.dtsi"
#include "sdm630-mdss-panels.dtsi"
#include "sdm630-mtp.dtsi"
#include "sdm630-regulator.dtsi"
#include "sdm660-audio.dtsi"
#include "sdm660-common.dtsi"
#include "sdm660-lpi.dtsi"
#include "sdm660-pinctrl.dtsi"
